/**
  ******************************************************************************
  * @file    OLED_IIC.c
  * @author  ThreeWater
  * @version V1.0.0
  * @date    17-June-2019
  * @brief  This article will be used for  driving  DL-33N.
  * @License:none         
  ******************************************************************************
  * @attention
  *	The frequency of crystal oscillator is 12 Mhz.
  * using OLED_IIC_Setup() to initialize.
  * 
  * 
  *
  * 
  ******************************************************************************
	**/

#include "OLED_IIC.h"
#include "stdlib.h"
#include <stdio.h>
#include <string.h>

static void OLED_IIC_Start(void);
static void OLED_IIC_Stop(void);
static void Write_OLED_IIC_Command(unsigned char OLED_IIC_Command);
static void Write_OLED_IIC_Data(unsigned char OLED_IIC_Data);
static void Write_OLED_IIC_Byte(unsigned char OLED_IIC_Byte);
static void OLED_IIC_Wait_Ack();

//========================================================================
// name:  fill_picture() 
// descrption:Fill with Picture
// param: fill_Data.using the software to get the data.
// return: none.
// version: VER1.0.0
// date: 17-June-2019
// attention: none
//========================================================================
void fill_picture(unsigned char fill_Data)
{
	unsigned char m,n;
	for(m=0;m<8;m++)
	{
		OLED_WR_Byte(0xb0+m,0);		//page0-page1
		OLED_WR_Byte(0x00,0);		//low column start address
		OLED_WR_Byte(0x10,0);		//high column start address
		for(n=0;n<128;n++)
			{
				OLED_WR_Byte(fill_Data,1);
			}
	}
}


//========================================================================
// name:  OLED_Set_Pos() 
// descrption:Set the position of de cursion
// param: x,y.the position
// return: none.
// version: VER1.0.0
// date: 17-June-2019
// attention: none
//========================================================================
void OLED_Set_Pos(unsigned char x, unsigned char y) 
{ 	OLED_WR_Byte(0xb0+y,OLED_CMD);
	OLED_WR_Byte(((x&0xf0)>>4)|0x10,OLED_CMD);
	OLED_WR_Byte((x&0x0f),OLED_CMD); 
}   	  

//========================================================================
// name:  OLED_Display_On() 
// descrption:Enable the OLED
// param: none
// return: none.
// version: VER1.0.0
// date: 17-June-2019
// attention: none
//========================================================================
void OLED_Display_On(void)
{
	OLED_WR_Byte(0X8D,OLED_CMD);  //SET DCDC命令
	OLED_WR_Byte(0X14,OLED_CMD);  //DCDC ON
	OLED_WR_Byte(0XAF,OLED_CMD);  //DISPLAY ON
}

//========================================================================
// name:  OLED_Display_Off() 
// descrption:Disable the OLED
// param: none
// return: none.
// version: VER1.0.0
// date: 17-June-2019
// attention: none
//========================================================================  
void OLED_Display_Off(void)
{
	OLED_WR_Byte(0X8D,OLED_CMD);  //SET DCDC命令
	OLED_WR_Byte(0X10,OLED_CMD);  //DCDC OFF
	OLED_WR_Byte(0XAE,OLED_CMD);  //DISPLAY OFF
}		   			 

//========================================================================
// name:  OLED_Clear() 
// descrption:Clear the OLED
// param: none
// return: none.
// version: VER1.0.0
// date: 17-June-2019
// attention: none
//========================================================================    
void OLED_Clear(void)  
{  
	unsigned char i,n;		    
	for(i=0;i<8;i++)  
	{  
		OLED_WR_Byte (0xb0+i,OLED_CMD);    //设置页地址（0~7）
		OLED_WR_Byte (0x00,OLED_CMD);      //设置显示位置—列低地址
		OLED_WR_Byte (0x10,OLED_CMD);      //设置显示位置—列高地址   
		for(n=0;n<128;n++)OLED_WR_Byte(0,OLED_DATA); 
	} //更新显示
}

//========================================================================
// name:  OLED_On() 
// descrption:Enable the OLED
// param: none
// return: none.
// version: VER1.0.0
// date: 17-June-2019
// attention: none
//========================================================================    
void OLED_On(void)  
{  
	unsigned char i,n;		    
	for(i=0;i<8;i++)  
	{  
		OLED_WR_Byte (0xb0+i,OLED_CMD);    //设置页地址（0~7）
		OLED_WR_Byte (0x00,OLED_CMD);      //设置显示位置—列低地址
		OLED_WR_Byte (0x10,OLED_CMD);      //设置显示位置—列高地址   
		for(n=0;n<128;n++)OLED_WR_Byte(1,OLED_DATA); 
	} //更新显示
}


//========================================================================
// name:  OLED_ShowChar() 
// descrption: To use the show string
// param: as the OLED_ShowString
// return: none.
// version: VER1.0.0
// date: 17-June-2019
// attention: none
//========================================================================  
void OLED_ShowChar(unsigned char x,unsigned char y,unsigned char chr,unsigned char Char_Size)
{      	
	unsigned char c=0,i=0;	
        c=chr-' ';//得到偏移后的值			
        if(x>Max_Column-1){x=0;y=y+2;}
        if(Char_Size ==16)
        {
          OLED_Set_Pos(x,y);	
          for(i=0;i<8;i++)
           OLED_WR_Byte(F8X16[c*16+i],OLED_DATA);
          OLED_Set_Pos(x,y+1);
          for(i=0;i<8;i++)
            OLED_WR_Byte(F8X16[c*16+i+8],OLED_DATA);
        }
        else {	
          OLED_Set_Pos(x,y);
           for(i=0;i<6;i++)
          OLED_WR_Byte(F6x8[c][i],OLED_DATA);
				
        }
}


//========================================================================
// name:  oled_pow() 
// descrption:none
// param: none
// return: none.
// version: VER1.0.0
// date: 17-June-2019
// attention: none
//========================================================================  
int oled_pow(unsigned char m,unsigned char n)
{
	int result=1;	 
	while(n--)result*=m;    
	return result;
}				  

//========================================================================
// name:  OLED_ShowNum() 
// descrption:Show numbers
// param: x,y postion
//        num the number
//        len the lenth of the number
//        mode 	0 fill mode; 1 overlay mode
// return: none.
// version: VER1.0.0
// date: 17-June-2019
// attention: none
//========================================================================  
void OLED_ShowNum(unsigned char x,unsigned char y,unsigned int num,unsigned char len,unsigned char size2)
{         	
	unsigned char t,temp;
	unsigned char enshow=0;						   
	for(t=0;t<len;t++)
	{
		temp=(num/oled_pow(10,len-t-1))%10;
		if(enshow==0&&t<(len-1))
		{
			if(temp==0)
			{
				OLED_ShowChar(x+(size2/2)*t,y,' ',size2);
				continue;
			}else enshow=1; 
		 	 
		}
	 	OLED_ShowChar(x+(size2/2)*t,y,temp+'0',size2); 
	}
} 

//========================================================================
// name:  OLED_ShowString() 
// descrption:Show Strings
// param: x,y,the postion
//        ch string that you want to show
//        Char_Size size: 12 or 16
// return: none.
// version: VER1.0.0
// date: 17-June-2019
// attention: none
//========================================================================  
//显示一个字符号串
void OLED_ShowString(unsigned char x,unsigned char y,unsigned char *chr,unsigned char Char_Size)
{
	unsigned char j=0;
	while (chr[j]!='\0')
	{		OLED_ShowChar(x,y,chr[j],Char_Size);
			x+=8;
		if(x>120){x=0;y+=2;}
			j++;
	}
}

//========================================================================
// name:  OLED_ShowCHinese() 
// descrption:Show chinese from the library,the library at the end of the file
// param: x,y postion
//        no the number of the lilbrary
// return: none.
// version: VER1.0.0
// date: 17-June-2019
// attention: none
//========================================================================  
void OLED_ShowCHinese(unsigned char x,unsigned char y,unsigned char no)
{      			    
	unsigned char t,adder=0;
	OLED_Set_Pos(x,y);	
    for(t=0;t<16;t++)
		{
				OLED_WR_Byte(Hzk[2*no][t],OLED_DATA);
				adder+=1;
     }	
		OLED_Set_Pos(x,y+1);	
    for(t=0;t<16;t++)
			{	
				OLED_WR_Byte(Hzk[2*no+1][t],OLED_DATA);
				adder+=1;
      }					
}


//========================================================================
// name:  OLED_DrawBMP() 
// descrption:Enable the OLED
// param: x0,y0,the start position 
//        x1,Y1,the end position
//        x(0~127) y(0~7)
//        BMP[] the BMO's data
// return: none.
// version: VER1.0.0
// date: 17-June-2019
// attention: none
//========================================================================  
void OLED_DrawBMP(unsigned char x0, unsigned char y0,unsigned char x1, unsigned char y1,unsigned char BMP[])
{ 	
 unsigned int j=0;
 unsigned char x,y;
  
  if(y1%8==0) y=y1/8;      
  else y=y1/8+1;
	for(y=y0;y<y1;y++)
	{
		OLED_Set_Pos(x0,y);
    for(x=x0;x<x1;x++)
	    {      
	    	OLED_WR_Byte(BMP[j++],OLED_DATA);	    	
	    }
	}
} 

//========================================================================
// name:  OLED_IIC_Setup() 
// descrption:Setup the OLED
// param: none
// return: none.
// version: VER1.0.0
// date: 17-June-2019
// attention: none
//========================================================================  			    
void OLED_IIC_Setup(void)
{ 
	
  OLED_WR_Byte(0xAE,OLED_CMD);//--display off
	OLED_WR_Byte(0x00,OLED_CMD);//---set low column address
	OLED_WR_Byte(0x10,OLED_CMD);//---set high column address
	OLED_WR_Byte(0x40,OLED_CMD);//--set start line address  
	OLED_WR_Byte(0xB0,OLED_CMD);//--set page address
	OLED_WR_Byte(0x81,OLED_CMD); // contract control
	OLED_WR_Byte(0xFF,OLED_CMD);//--128   
	OLED_WR_Byte(0xA1,OLED_CMD);//set segment remap 
	OLED_WR_Byte(0xA6,OLED_CMD);//--normal / reverse
	OLED_WR_Byte(0xA8,OLED_CMD);//--set multiplex ratio(1 to 64)
	OLED_WR_Byte(0x3F,OLED_CMD);//--1/32 duty
	OLED_WR_Byte(0xC8,OLED_CMD);//Com scan direction
	OLED_WR_Byte(0xD3,OLED_CMD);//-set display offset
	OLED_WR_Byte(0x00,OLED_CMD);//
	
	OLED_WR_Byte(0xD5,OLED_CMD);//set osc division
	OLED_WR_Byte(0x80,OLED_CMD);//
	
	OLED_WR_Byte(0xD8,OLED_CMD);//set area color mode off
	OLED_WR_Byte(0x05,OLED_CMD);//
	
	OLED_WR_Byte(0xD9,OLED_CMD);//Set Pre-Charge Period
	OLED_WR_Byte(0xF1,OLED_CMD);//
	
	OLED_WR_Byte(0xDA,OLED_CMD);//set com pin configuartion
	OLED_WR_Byte(0x12,OLED_CMD);//
	
	OLED_WR_Byte(0xDB,OLED_CMD);//set Vcomh
	OLED_WR_Byte(0x30,OLED_CMD);//
	
	OLED_WR_Byte(0x8D,OLED_CMD);//set charge pump enable
	OLED_WR_Byte(0x14,OLED_CMD);//
	
	OLED_WR_Byte(0xAF,OLED_CMD);//--turn on oled panel
  OLED_Clear();
}  









static void delay()
{
	unsigned int i=50;
	while(i--);
}


// IIC
void OLED_IIC_Start()
{
	OLED_SCLK_SET() ;
	OLED_SDIN_SET();
	 delay();
	OLED_SDIN_CLR();
	 delay();
	OLED_SCLK_CLR();
	 delay();
}

void OLED_IIC_Stop()
{
	OLED_SCLK_SET() ;
	 delay();
	OLED_SDIN_CLR();
	delay();
	OLED_SDIN_SET();
	delay();
}


void OLED_IIC_Wait_Ack()
{
	OLED_SCLK_SET() ;
	delay();
	OLED_SCLK_CLR();
	delay();
}


void Write_OLED_IIC_Byte(unsigned char OLED_IIC_Byte)
{
	unsigned char i;
	unsigned char m,da;
	da=OLED_IIC_Byte;
	OLED_SCLK_CLR();
	for(i=0;i<8;i++)		
	{
			m=da;
		m=m&0x80;
		if(m==0x80)
		{OLED_SDIN_SET();}
		else OLED_SDIN_CLR();
			da=da<<1;
		OLED_SCLK_SET();
		OLED_SCLK_CLR();
		}
}

void Write_OLED_IIC_Command(unsigned char OLED_IIC_Command)
{
   OLED_IIC_Start();
   Write_OLED_IIC_Byte(0x78);            //Slave address,SA0=0
	OLED_IIC_Wait_Ack();	
   Write_OLED_IIC_Byte(0x00);			//write command
	OLED_IIC_Wait_Ack();	
   Write_OLED_IIC_Byte(OLED_IIC_Command); 
	OLED_IIC_Wait_Ack();	
   OLED_IIC_Stop();
}


void Write_OLED_IIC_Data(unsigned char OLED_IIC_Data)
{
   OLED_IIC_Start();
   Write_OLED_IIC_Byte(0x78);			//D/C#=0; R/W#=0
	OLED_IIC_Wait_Ack();	
   Write_OLED_IIC_Byte(0x40);			//write data
	OLED_IIC_Wait_Ack();	
   Write_OLED_IIC_Byte(OLED_IIC_Data);
	OLED_IIC_Wait_Ack();	
   OLED_IIC_Stop();
}

void OLED_WR_Byte(unsigned dat,unsigned cmd)
{
	if(cmd)
	{
		Write_OLED_IIC_Data(dat);
	}
	else {
   Write_OLED_IIC_Command(dat);
	}
}


const unsigned char code  F6x8[][6] =		
{
0x00, 0x00, 0x00, 0x00, 0x00, 0x00,// sp
0x00, 0x00, 0x00, 0x2f, 0x00, 0x00,// !
0x00, 0x00, 0x07, 0x00, 0x07, 0x00,// "
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0x14, 0x14, 0x14, 0x14, 0x14, 0x14,// horiz lines
};
/****************************************8*16的点阵************************************/
const unsigned char code F8X16[]=	  
{
  0x00,0x00,0x00,0x00,0x00,0x00,0x00,0x00,0x00,0x00,0x00,0x00,0x00,0x00,0x00,0x00,// 0
  0x00,0x00,0x00,0xF8,0x00,0x00,0x00,0x00,0x00,0x00,0x00,0x33,0x30,0x00,0x00,0x00,//! 1
  0x00,0x10,0x0C,0x06,0x10,0x0C,0x06,0x00,0x00,0x00,0x00,0x00,0x00,0x00,0x00,0x00,//" 2
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  0x00,0x06,0x01,0x01,0x02,0x02,0x04,0x04,0x00,0x00,0x00,0x00,0x00,0x00,0x00,0x00,//~ 94
};
char code Hzk[][16]={

{0x00,0x00,0x40,0x40,0x40,0x40,0x40,0xFF,0x40,0x40,0x40,0x40,0x40,0x00,0x00,0x00},
{0x40,0x40,0x40,0x40,0x40,0x40,0x40,0x7F,0x40,0x40,0x40,0x40,0x40,0x40,0x40,0x00},/*"土",0*/

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{0x88,0x48,0x2F,0x09,0x09,0x19,0xAF,0x48,0x30,0x0F,0x02,0x42,0x82,0x7F,0x00,0x00},/*"期",1*/
};



